## main/Kconfig.projbuild
```kconfig
menu "Example Configuration"

    config EXAMPLE_FIRMWARE_UPGRADE_URL
        string "firmware upgrade url endpoint"
        default "https://192.168.0.3:8070/hello-world.bin"
        help
            URL of server which hosts the firmware
            image.

    config EXAMPLE_FIRMWARE_UPGRADE_URL_FROM_STDIN
        bool
        default y if EXAMPLE_FIRMWARE_UPGRADE_URL = "FROM_STDIN"

    config EXAMPLE_SKIP_COMMON_NAME_CHECK
        bool "Skip server certificate CN fieldcheck"
        default n
        help
            This allows you to skip the validation of OTA server certificate CN field.

    config EXAMPLE_FIRMWARE_UPGRADE_BIND_IF
        bool "Support firmware upgrade bind specified interface"
        default n
        help
            This allows you to bind specified interface in OTA example.

    choice EXAMPLE_FIRMWARE_UPGRADE_BIND_IF_TYPE
        prompt "Choose OTA data bind interface"
        default EXAMPLE_FIRMWARE_UPGRADE_BIND_IF_STA
        depends on EXAMPLE_FIRMWARE_UPGRADE_BIND_IF
        help
            Select which interface type of OTA data go through.

        config EXAMPLE_FIRMWARE_UPGRADE_BIND_IF_STA
            bool "Bind wifi station interface"
            depends on EXAMPLE_CONNECT_WIFI
            help
                Select wifi station interface to pass the OTA data.

        config EXAMPLE_FIRMWARE_UPGRADE_BIND_IF_ETH
            bool "Bind ethernet interface"
            depends on EXAMPLE_CONNECT_ETHERNET
            help
                Select ethernet interface to pass the OTA data.
    endchoice
	
	
endmenu
config XCLK_FREQ
    int "XCLK Frequency"
    default "20000000"
    help
        The XCLK Frequency in Herz.

      
menu "Pin Configuration"
    config D0
        int "D0"
        default "5"
    config D1
        int "D1"
        default "18"
    config D2
        int "D2"
        default "19"
    config D3
        int "D3"
        default "21"
    config D4
        int "D4"
        default "36"
    config D5
        int "D5"
        default "39"
    config D6
        int "D6"
        default "34"
    config D7
        int "D7"
        default "35"
    config XCLK
        int "XCLK"
        default "0"
    config PCLK
        int "PCLK"
        default "22"
    config VSYNC
        int "VSYNC"
        default "25"
    config HREF
        int "HREF"
        default "23"
    config SDA
        int "SDA"
        default "26"
    config SCL
        int "SCL"
        default "27"
    config RESET
        int "RESET"
        default "32"
endmenu
```

## sdkconfig.defaults
```kconfig
# Override some defaults so BT stack is enabled
# in this example

#
# BT config
#
CONFIG_BT_ENABLED=y
CONFIG_BTDM_CTRL_MODE_BLE_ONLY=y
CONFIG_BTDM_CTRL_MODE_BR_EDR_ONLY=n
CONFIG_BTDM_CTRL_MODE_BTDM=n
CONFIG_BT_BLUEDROID_ENABLED=n
CONFIG_BT_NIMBLE_ENABLED=y


CONFIG_XCLK_FREQ=10000000

#
# Pin Configuration
#
CONFIG_D0=5
CONFIG_D1=18
CONFIG_D2=19
CONFIG_D3=21
CONFIG_D4=36
CONFIG_D5=39
CONFIG_D6=2
CONFIG_D7=35
CONFIG_PCLK=22
CONFIG_VSYNC=25
CONFIG_HREF=23
CONFIG_SDA=26
CONFIG_SCL=27
CONFIG_QR_RECOGNIZE=
```
